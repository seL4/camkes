## apps/testrefin/Kconfig
```kconfig
# @TAG(DATA61_BSD)
#

config APP_TESTREFIN
    bool "Test refin parameters"
    default n
```

## apps/testreplycapprotection/Kconfig
```kconfig
# @TAG(DATA61_BSD)
#

config APP_TESTREPLYCAPPROTECTION
    bool "Test reply cap protection"
    default n
```

## apps/testsel4notification/Kconfig
```kconfig
# @TAG(DATA61_BSD)
#

config APP_TESTSEL4NOTIFICATION
    bool "Test seL4Notification connector"
    default n
```

## apps/testsingleaddressspaceheap/Kconfig
```kconfig
# @TAG(DATA61_BSD)
#

config APP_TESTSINGLEADDRESSSPACEHEAP
    bool "Test heap semantics for single address space components"
    default n
```

## apps/teststringarrays/Kconfig
```kconfig
# @TAG(NICTA_BSD)
#

config APP_TESTSTRINGARRAYS
    bool "Test some unorthodox combinations of string arrays"
    default n
```

## apps/testsyscalls/Kconfig
```kconfig
# @TAG(NICTA_BSD)
#

config APP_TESTSYSCALLS
    bool "Test POSIX environment"
    default n
```

## apps/testunderscorename/Kconfig
```kconfig
# @TAG(NICTA_BSD)
#

config APP_TESTUNDERSCORENAME
    bool "Test an unusual interface name"
    default n
```

## apps/uart/Kconfig
```kconfig
#
# Copyright 2017, Data61
# Commonwealth Scientific and Industrial Research Organisation (CSIRO)
# ABN 41 687 119 230.
#
# This software may be distributed and modified according to the terms of
# the BSD 2-Clause license. Note that NO WARRANTY is provided.
# See "LICENSE_BSD2.txt" for details.
#
# @TAG(DATA61_BSD)
#
#

config APP_UART
    bool "UART driver example for ARM-KZM"
    default n
    depends on ARCH_ARM
    help
        An example of ARM UART driver on CAmkES.
```

## cs-donate/Kconfig
```kconfig
#
# Copyright 2015, NICTA
#
# This software may be distributed and modified according to the terms of
# the BSD 2-Clause license. Note that NO WARRANTY is provided.
# See "LICENSE_BSD2.txt" for details.
#
# @TAG(NICTA_BSD)
#

config APP_CS_DONATE
    bool "client server sc donate test"
    default n
    help
        CAmkES RT test: client server scenario, server does not have its own scheduling context.
```

## cs-nodonate/Kconfig
```kconfig
#
# Copyright 2015, NICTA
#
# This software may be distributed and modified according to the terms of
# the BSD 2-Clause license. Note that NO WARRANTY is provided.
# See "LICENSE_BSD2.txt" for details.
#
# @TAG(NICTA_BSD)
#

config APP_CS_NODONATE
    bool "client server no sc donate test"
    default n
    help
        CAmkES RT test: client server scenario, client and server each have their own scheduling context.
```

## event-driven-donate/Kconfig
```kconfig
#
# Copyright 2015, NICTA
#
# This software may be distributed and modified according to the terms of
# the BSD 2-Clause license. Note that NO WARRANTY is provided.
# See "LICENSE_BSD2.txt" for details.
#
# @TAG(NICTA_BSD)
#

config APP_EVENT_DONATE
    bool "Event-driven donate test app "
    default n
    help
        CAmkES RT test: sender receiver scenario.
	The sender donates scheduling context to the receiver.
```

## libs/libsel4bga/Kconfig
```kconfig
#
# Copyright 2017, Data61
# Commonwealth Scientific and Industrial Research Organisation (CSIRO)
# ABN 41 687 119 230.
#
# This software may be distributed and modified according to the terms of
# the BSD 2-Clause license. Note that NO WARRANTY is provided.
# See "LICENSE_BSD2.txt" for details.
#
# @TAG(DATA61_BSD)
#
#

config LIB_SEL4_BGA
    bool "BGA Driver"
    depends on LIB_SEL4 && HAVE_LIBC
    default y
    help
        Build a basic driver for the Bochs Graphics Adaptor
```

## mcs-donate/Kconfig
```kconfig
#
# Copyright 2015, NICTA
#
# This software may be distributed and modified according to the terms of
# the BSD 2-Clause license. Note that NO WARRANTY is provided.
# See "LICENSE_BSD2.txt" for details.
#
# @TAG(NICTA_BSD)
#

config APP_MCS_DONATE
    bool "Multiple client single server sc donate test"
    default n
    help
        CAmkES RT test: multiple client server scenario, server does not have its own scheduling context.
```

## mcs-nodonate/Kconfig
```kconfig
#
# Copyright 2015, NICTA
#
# This software may be distributed and modified according to the terms of
# the BSD 2-Clause license. Note that NO WARRANTY is provided.
# See "LICENSE_BSD2.txt" for details.
#
# @TAG(NICTA_BSD)
#

config APP_MCS_NODONATE
    bool "Multiple client single server no sc donate test"
    default n
    help
        CAmkES RT test: multiple client server scenario, client and server each have their own scheduling context.
```

## periodic/Kconfig
```kconfig
#
# Copyright 2015, NICTA
#
# This software may be distributed and modified according to the terms of
# the BSD 2-Clause license. Note that NO WARRANTY is provided.
# See "LICENSE_BSD2.txt" for details.
#
# @TAG(NICTA_BSD)
#

config APP_PERIODIC
    bool "periodic execution test app"
    default n
    help
        CAmkES RT test: multiple components each with different priorities and budget/period ratios.
```
