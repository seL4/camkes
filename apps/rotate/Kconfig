## apps/rotate/Kconfig
```kconfig
# @TAG(NICTA_BSD)
#

config APP_ROTATE
    bool "Rotation example"
    default n
    help
        An example that uses the various permutations of user-defined types.
```

## apps/rumprun_ethernet/Kconfig
```kconfig
# @TAG(DATA61_BSD)
#



config APP_RUMPRUN_ETHERNET
    bool "rumprun ethernet CAmkES application"
    default n
    help
        A simple rumprun app that reverses strings over a TCP connection
```

## apps/rumprun_hello/Kconfig
```kconfig
# @TAG(DATA61_BSD)
#



config APP_RUMPRUN_HELLO
    bool "rumprun hello CAmkES application"
    default n
    help
        A simple rumprun hello app
```

## apps/rumprun_pthreads/Kconfig
```kconfig
# @TAG(DATA61_BSD)
#



config APP_RUMPRUN_PTHREADS
    bool "rumprun pthreads CAmkES application"
    default n
    help
        A simple rumprun pthreads app
```

## apps/simple/Kconfig
```kconfig
# @TAG(DATA61_BSD)
#

config APP_SIMPLE
    bool "Simple CAmkES application"
    default n
    help
        A simple application to demonstrate CAmkES functionality.
```

## apps/simplesingleaddressspace/Kconfig
```kconfig
# @TAG(DATA61_BSD)
#

config APP_SIMPLESINGLEADDRESSSPACE
    bool "Simple single address space CAmkES application"
    default n
```

## apps/socket/Kconfig
```kconfig
# @TAG(DATA61_BSD)
#

config APP_SOCKET
    bool "Socket CAmkES application"
    default n
    help
        An example of user-defined dataports.
```

## apps/structs/Kconfig
```kconfig
# @TAG(DATA61_BSD)
#

config APP_STRUCTS
    bool "structs CAmkES application"
    default n
    help
        An example of structs as attribute types.
```

## apps/swapcounter/Kconfig
```kconfig
#
# Copyright 2017, Data61
# Commonwealth Scientific and Industrial Research Organisation (CSIRO)
# ABN 41 687 119 230.
#
# This software may be distributed and modified according to the terms of
# the BSD 2-Clause license. Note that NO WARRANTY is provided.
# See "LICENSE_BSD2.txt" for details.
#
# @TAG(DATA61_BSD)
#
#

config APP_SWAPCOUNTER
    bool "Swap counter (FM2015 example)"
    default n
    help
        An example application that swaps two values and increments a global
        counter. This was used as an example in our submission to
        Formal Methods 2015.
```

## apps/terminal/Kconfig
```kconfig
# @TAG(NICTA_BSD)
#

config APP_TERMINAL
    bool "Secure terminal prototype"
    default n
    help
        A prototype for a secure terminal implementation.
```

## apps/testbufvariant/Kconfig
```kconfig
# @TAG(DATA61_BSD)
#

config APP_TESTBUFVARIANT
    bool "Test Buf variant syntax"
    default n
```

## apps/testcamkes438/Kconfig
```kconfig
#
# Copyright 2017, Data61
# Commonwealth Scientific and Industrial Research Organisation (CSIRO)
# ABN 41 687 119 230.
#
# This software may be distributed and modified according to the terms of
# the BSD 2-Clause license. Note that NO WARRANTY is provided.
# See "LICENSE_BSD2.txt" for details.
#
# @TAG(DATA61_BSD)
#
#

config APP_TESTCAMKES438
    bool "Test reply cap trampling"
    default n
    help
        This application tests for a regression of a previous bug whereby the
        saving of a reply cap in advance of RPC payload unmarshalling would
        cause the contents of the IPC buffer to be trampled.
```

## apps/testcontrolname/Kconfig
```kconfig
# @TAG(DATA61_BSD)
#

config APP_TESTCONTROLNAME
    bool "Test of an interface named _control"
    default n
```

## apps/testdataportbifurcate/Kconfig
```kconfig
# @TAG(NICTA_BSD)
#

config APP_TESTDATAPORTBIFURCATE
    bool "Test multiple dataports to the same window"
    default n
```

## apps/testdataportmux/Kconfig
```kconfig
# @TAG(DATA61_BSD)
#

config APP_TESTDATAPORTMUX
    bool "Test N-to-M dataports"
    default n
```

## apps/testdataportmuxflat/Kconfig
```kconfig
# @TAG(DATA61_BSD)
#

config APP_TESTDATAPORTMUXFLAT
    bool "Test N-to-M dataports flattened"
    default n
```

## apps/testdataportptrwrap/Kconfig
```kconfig
# @TAG(DATA61_BSD)
#

config APP_TESTDATAPORTPTRWRAP
    bool "Test dataport wrapping functionality"
    default n
```

## apps/testdataportrpc/Kconfig
```kconfig
# @TAG(DATA61_BSD)
#

config APP_TESTDATAPORTRPC
    bool "Test using dataports to back RPC connections"
    default n
```

## apps/testfaulthandlers/Kconfig
```kconfig
# @TAG(DATA61_BSD)
#

config APP_TESTFAULTHANDLERS
    bool "Test debug fault handling"
    default n
```

## apps/testgrouping/Kconfig
```kconfig
# @TAG(DATA61_BSD)
#

config APP_TESTGROUPING
    bool "Test various semantics of grouping components"
    default n
```

## apps/testgroupingcontrol/Kconfig
```kconfig
# @TAG(DATA61_BSD)
#

config APP_TESTGROUPINGCONTROL
    bool "Testing grouping two control components"
    default n
    help
        This application tests a scenario where two component instances which
        both have control threads are grouped together in a single address
        space. If this works correctly, both control threads should exist and
        be able to operate independently.

        This was never actually a CAmkES bug, but my own paranoia made me think
        this case might be buggy. It remains a good case to regularly test to
        ensure we do not break this functionality.
```

## apps/testhardwareinterrupt/Kconfig
```kconfig
# @TAG(NICTA_BSD)
#

config APP_TESTHARDWAREINTERRUPT
    bool "Test seL4HardwareInterrupt"
    default n
```

## apps/testltouser/Kconfig
```kconfig
#
# Copyright 2017, Data61
# Commonwealth Scientific and Industrial Research Organisation (CSIRO)
# ABN 41 687 119 230.
#
# This software may be distributed and modified according to the terms of
# the BSD 2-Clause license. Note that NO WARRANTY is provided.
# See "LICENSE_BSD2.txt" for details.
#
# @TAG(DATA61_BSD)
#
#

config APP_TESTLTOUSER
    bool "Test link-time optimisations within a component"
    default n
    help
        This application tests that link-time optimisations can be correctly
        applied to a CAmkES component to optimise user code across modules.
        XXX: Note that LTO support is currently broken in CAmkES.
```

## apps/testnto1mmio/Kconfig
```kconfig
# @TAG(NICTA_BSD)
#

config APP_TESTNTO1MMIO
    bool "Test compilation of multiplexed MMIO"
    default n
```

## apps/testnto1overload/Kconfig
```kconfig
# @TAG(DATA61_BSD)
#

config APP_TESTNTO1OVERLOAD
    bool "Test N-to-1 from a single component"
    default n
```
