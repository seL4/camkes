## Kconfig
```kconfig
#
# Copyright 2017, Data61
# Commonwealth Scientific and Industrial Research Organisation (CSIRO)
# ABN 41 687 119 230.
#
# This software may be distributed and modified according to the terms of
# the BSD 2-Clause license. Note that NO WARRANTY is provided.
# See "LICENSE_BSD2.txt" for details.
#
# @TAG(DATA61_BSD)
#
#

mainmenu "CAmkES project configuration"

config COMMON_PATH
    string
    option env="COMMON_PATH"

menu "Kernel"
    source "kernel/Kconfig"
endmenu

menu "Libraries"
    source "libs/libmuslc/Kconfig"
    source "libs/libsel4/Kconfig"
    source "libs/libsel4muslcsys/Kconfig"
    source "libs/libsel4muslccamkes/Kconfig"
    source "libs/libsel4platsupport/Kconfig"
    source "libs/libsel4allocman/Kconfig"
    source "libs/libsel4utils/Kconfig"
    source "libs/libcpio/Kconfig"
    source "libs/libelf/Kconfig"
    source "libs/libsel4bench/Kconfig"
    source "libs/libsel4sync/Kconfig"
    source "libs/libsel4vspace/Kconfig"
    source "libs/libsel4vka/Kconfig"
    source "libs/libplatsupport/Kconfig"
    source "libs/libsel4debug/Kconfig"
    source "libs/libutils/Kconfig"
    source "libs/libsel4simple/Kconfig"
    source "libs/libsel4simple-default/Kconfig"
    source "libs/libsel4bga/Kconfig"
    source "libs/rumprun/Kconfig"
endmenu

menu "Applications"
    source "apps/capdl-loader-experimental/Kconfig"
    source "apps/uart/Kconfig"
    source "apps/epit/Kconfig"
    source "apps/keyboard/Kconfig"
    source "apps/attributes/Kconfig"
    source "apps/simple/Kconfig"
    source "apps/dataport/Kconfig"
    source "apps/event/Kconfig"
    source "apps/filter/Kconfig"
    source "apps/terminal/Kconfig"
    source "apps/mutex/Kconfig"
    source "apps/lockserver/Kconfig"
    source "apps/multiclient/Kconfig"
    source "apps/multiassembly/Kconfig"
    source "apps/hierarchical-components/Kconfig"
    source "apps/hierarchical-attributes/Kconfig"
    source "apps/global-imports/Kconfig"
    source "apps/swapcounter/Kconfig"
    source "apps/aeroplage/Kconfig"
    source "apps/binary-semaphore/Kconfig"
    source "apps/reversestring/Kconfig"

    source "apps/rotate/Kconfig"
    source "apps/dma-example/Kconfig"
    source "apps/adder/Kconfig"
    source "apps/structs/Kconfig"
    source "apps/socket/Kconfig"
    source "apps/multiplier/Kconfig"
    source "apps/exchangestring/Kconfig"
    source "apps/dhcp/Kconfig"
    source "apps/testsel4notification/Kconfig"
    source "apps/testdataportmux/Kconfig"
    source "apps/testunderscorename/Kconfig"
    source "apps/testrefin/Kconfig"
    source "apps/testfaulthandlers/Kconfig"
    source "apps/testcontrolname/Kconfig"
    source "apps/simplesingleaddressspace/Kconfig"
    source "apps/testsingleaddressspaceheap/Kconfig"
    source "apps/testgrouping/Kconfig"
    source "apps/testgroupingcontrol/Kconfig"
    source "apps/teststringarrays/Kconfig"
    source "apps/testhardwareinterrupt/Kconfig"
    source "apps/testreplycapprotection/Kconfig"
    source "apps/testdataportptrwrap/Kconfig"
    source "apps/testnto1mmio/Kconfig"
    source "apps/testnto1overload/Kconfig"
    source "apps/testbufvariant/Kconfig"
    source "apps/testdataportmuxflat/Kconfig"
    source "apps/testdataportbifurcate/Kconfig"
    source "apps/testdataportrpc/Kconfig"
    source "apps/testcamkes438/Kconfig"
    source "apps/testltouser/Kconfig"
    source "apps/pit/Kconfig"
    source "apps/testsyscalls/Kconfig"
    source "apps/alignment/Kconfig"
    source "apps/rumprun_pthreads/Kconfig"
    source "apps/rumprun_hello/Kconfig"
    source "apps/rumprun_ethernet/Kconfig"
endmenu

source "tools/camkes/Kconfig"
source "$COMMON_PATH/Kconfig"
```

## apps/adder/Kconfig
```kconfig
# @TAG(NICTA_BSD)
#

config APP_ADDER
    bool "Adder CAmkES application"
    default n
    help
        An example of passing dataport pointers across an interface.
```

## apps/aeroplage/Kconfig
```kconfig
# @TAG(NICTA_BSD)
#

config APP_AEROPLAGE
    bool "Multi-level secure terminal prototype (mark 1)"
    default n
    help
        A prototype of a multi-level secure terminal constructed as a case
        study for HiSeas.
```

## apps/alignment/Kconfig
```kconfig
# @TAG(DATA61_BSD)
#

config APP_ALIGNMENT
    bool "App intended to crash if stack is incorrectly aligned"
    default n
    help
        App intended to crash if stack is incorrectly aligned"
```

## apps/attributes/Kconfig
```kconfig
# @TAG(DATA61_BSD)
#

config APP_ATTRIBUTES
    bool "attributes CAmkES application"
    default n
    help
        An example of hierarchical attributes.
```

## apps/binary-semaphore/Kconfig
```kconfig
# @TAG(DATA61_GPL)
#

config APP_BINARY_SEMAPHORE
    bool "Binary semaphore example"
    default n
    help
        An application demonstrating using a binary semaphore to serialise an async interface
```

## apps/cached-hardware-dataport/Kconfig
```kconfig
#
# Copyright 2014, NICTA
#
# This software may be distributed and modified according to the terms of
# the BSD 2-Clause license. Note that NO WARRANTY is provided.
# See "LICENSE_BSD2.txt" for details.
#
# @TAG(NICTA_BSD)
#

config APP_CACHED_HARDWARE_DATAPORT
    bool "Cached Hardware Dataports Example Application"
    default n
    help
        An example of using cached hardware dataports with a device
```

## apps/dataport/Kconfig
```kconfig
# @TAG(NICTA_BSD)
#

config APP_DATAPORT
    bool "Dataport CAmkES application"
    default n
    help
        A CAmkES application demonstrating the use of dataports
```

## apps/dhcp/Kconfig
```kconfig
#
# Copyright 2017, Data61
# Commonwealth Scientific and Industrial Research Organisation (CSIRO)
# ABN 41 687 119 230.
#
# This software may be distributed and modified according to the terms of
# the BSD 2-Clause license. Note that NO WARRANTY is provided.
# See "LICENSE_BSD2.txt" for details.
#
# @TAG(DATA61_BSD)
#
#

menuconfig APP_DHCP
    bool "DHCP server and clients"
    default n
    help
        An application based on a DHCP server setup with some clients. Intended
        to be the subject of a verification case study.

config APP_DHCP_DEBUG
    bool "Enable debug printing"
    default y
    depends on APP_DHCP
    help
        Enable debug print outs for this application.
```

## apps/dma-example/Kconfig
```kconfig
# @TAG(NICTA_BSD)
#

config APP_DMAEG
    bool "Example of DMA functionality"
    default n
    help
        Example of how to use the new DMA functionality.
```

## apps/epit/Kconfig
```kconfig
# @TAG(DATA61_BSD)
#

menuconfig APP_EPIT
    bool "EPIT driver example for ARM-KZM"
    default n
    depends on ARCH_ARM
    help
        An example of EPIT driver on CAmkES.
```

## apps/event/Kconfig
```kconfig
# @TAG(NICTA_BSD)
#

config APP_EVENT
    bool "Event CAmkES application"
    default n
    help
        An application to demonstrate events in CAmkES.
```

## apps/exchangestring/Kconfig
```kconfig
# @TAG(NICTA_BSD)
#

config APP_EXCHANGESTRING
    bool "Exchange string CAmkES application"
    default n
    help
        An example of string as procedure arguments.
```

## apps/filter/Kconfig
```kconfig
# @TAG(NICTA_BSD)
#

config APP_FILTER
    bool "CAmkES filter example"
    default n
    help
        A simple application showing use of a filter component.
```

## apps/global-imports/Kconfig
```kconfig
#
# Copyright 2016, NICTA
#
# This software may be distributed and modified according to the terms of
# the BSD 2-Clause license. Note that NO WARRANTY is provided.
# See "LICENSE_BSD2.txt" for details.
#
# @TAG(NICTA_BSD)
#

config APP_GLOBAL_IMPORTS
    bool "Including files from a global directory"
    help
        This app demonstrates including components and interfaces from some
        global include directory. The directories 'global/components' and
        'global/interfaces' are two such directories. They can be placed
        anywhere in the filesystem and the app will still compile. To have
        the compiler know where the include directories are, set the make option
        "Search path for components and interfaces" in the "CAmkES Options" section of menuconfig
        to "/path/to/global/components /path/to/global/interfaces".
```

## apps/hierarchical-attributes/Kconfig
```kconfig
# @TAG(NICTA_BSD)
#

config APP_HIERARCHICAL_ATTRIBUTES
    bool "Hierarchical Attributes Example"
    default n
    help
        CAmkES application demonstrating hierarchical attributes
```

## apps/hierarchical-components/Kconfig
```kconfig
# @TAG(DATA61_BSD)
#

config APP_HIERARCHICAL_COMPONENTS
    bool "CAmkES application demonstrating hierarchical components"
    default n
    help
        CAmkES application demonstrating hierarchical components"
```

## apps/keyboard/Kconfig
```kconfig
# @TAG(NICTA_BSD)
#

menuconfig APP_KEYBOARD
    bool "Keyboard example"
    default n
    depends on ARCH_IA32
    select MODULE_CAPDL_LOADER 
    help
        An example of using keyboard in CAmkES.
```

## apps/lockserver/Kconfig
```kconfig
# @TAG(DATA61_BSD)
#

config APP_LOCKSERVER
    bool "Lock server example"
    default n
    help
        An example of how to implement a lock server in CAmkES.
```

## apps/multiassembly/Kconfig
```kconfig
# @TAG(NICTA_BSD)
#

config APP_MULTIASSEMBLY
    bool "CAmkES application with multiple assembly blocks"
    default n
    help
        An example of separating code into multiple assembly blocks
```

## apps/multiclient/Kconfig
```kconfig
# @TAG(DATA61_BSD)
#

config APP_MULTICLIENT
    bool "Example of multi-clients connect to the same server."
    default n 
    help
        An application to demonstrate one server is connected to multiple clients.
```

## apps/multiplier/Kconfig
```kconfig
# @TAG(DATA61_BSD)
#

config APP_MULTIPLIER
    bool "Multiplier CAmkES application"
    default n
    help
        An example of arrays as procedure arguments.
```

## apps/mutex/Kconfig
```kconfig
# @TAG(NICTA_BSD)
#

config APP_MUTEX
    bool "Example locking application"
    default n
    help
        This application is an example of user-defined connectors in CAmkES.
```

## apps/pit/Kconfig
```kconfig
# @TAG(NICTA_BSD)
#

config APP_PIT
    bool "PIT driver example for X86"
    default n
    depends on ARCH_X86
    help
        An example of PIT driver on CAmkES.
```

## apps/reversestring/Kconfig
```kconfig
# @TAG(DATA61_BSD)
#

config APP_REVERSESTRING
    bool "Reverse String CAmkES application"
    default n
    help
        A CAmkES application that reverses a string in a dataport
```
